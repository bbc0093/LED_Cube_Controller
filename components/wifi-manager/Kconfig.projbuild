## components/wifi-manager/Kconfig.projbuild
```kconfig
menu "Wi-Fi"

    config WIFI_SSID
        string "Network SSID"
        default "myssid"
        help
            SSID of the Wi-Fi network to connect to.
            Set the real value in sdkconfig (gitignored) via idf.py menuconfig.

    config WIFI_PASSWORD
        string "Network password"
        default "mypassword"
        help
            Wi-Fi password. Leave empty for open networks.
            Set the real value in sdkconfig (gitignored) via idf.py menuconfig.

    config WIFI_MAX_RETRY
        int "Maximum connection retries"
        default 5
        range 1 20
        help
            Number of reconnection attempts before the driver gives up and sets
            the WIFI_FAIL_BIT event group bit.

endmenu
```

## sdkconfig.defaults
```kconfig
CONFIG_ESP_WIFI_SOFTAP_SUPPORT=n

# Wi-Fi credentials — override these in sdkconfig via: idf.py menuconfig
# sdkconfig is gitignored; this file (sdkconfig.defaults) is committed with
# safe placeholder values so the build always has a default.
CONFIG_WIFI_SSID="your_ssid_here"
CONFIG_WIFI_PASSWORD="your_password_here"
CONFIG_WIFI_MAX_RETRY=5
```
